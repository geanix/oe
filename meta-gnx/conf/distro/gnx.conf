## meta-gnx/conf/distro/gnx.conf
```bitbake
DISTRO_NAME = "Geanix"
DISTRO_VERSION = "0.1"

# Use the kernel/u-boot recipes from this layer
PREFERRED_PROVIDER_virtual/kernel = "linux-stable"
PREFERRED_PROVIDER_virtual/bootloader = "u-boot"

# KERNEL_IMAGETYPE is deprecated by KERNEL_IMAGETYPES,
# but must be unset to avoid overriding the latter.
KERNEL_IMAGETYPE = ""

# Default to zImage for except for arm64
KERNEL_IMAGETYPES = "Image"

# use systemd
DISTRO_FEATURES_append = " systemd"
DISTRO_FEATURES_remove = "sysvinit"
DISTRO_FEATURES_CONSIDERED += "sysvinit"
VIRTUAL-RUNTIME_init_manager = "systemd"
VIRTUAL-RUNTIME_initscripts = ""
VIRTUAL-RUNTIME_base-utils-syslog = ""
BAD_RECOMMENDATIONS_append = " udev-hwdb"

require conf/distro/include/yocto-uninative.inc

PACKAGECONFIG_pn-libgpiod = "python3"
INSANE_SKIP_libgpiod-python = "staticdev"
```

## meta-gnx/conf/machine/rpi3.conf
```bitbake
require conf/machine/include/tune-cortexa53.inc

# Raspberry Pi has no hardware clock
MACHINE_FEATURES_BACKFILL_CONSIDERED = "rtc"

# set default console
SERIAL_CONSOLES = "115200;ttyS1"

# Configure u-boot build
UBOOT_MACHINE = "rpi_arm64_defconfig"
UBOOT_BINARY = "u-boot.bin"

KERNEL_DEVICETREE = " \
    broadcom/bcm2837-rpi-3-b-plus.dtb \
    broadcom/bcm2837-rpi-3-b.dtb \
    broadcom/bcm2711-rpi-4-b.dtb \
"

KERNEL_OPTIONS = " \
    USB_SERIAL=m \
    USB_SERIAL_GENERIC=y \
    USB_SERIAL_SIMPLE=m \
    USB_SERIAL_FTDI_SIO=m \
    USB_SERIAL_PL2303=m \
    PINCTRL_MCP23S08=m \
"

# Configure installation of bootfiles and u-boot on first partition
WKS_FILE_DEPENDS = " \
    rpi-bootfiles \
    rpi-config \
    virtual/bootloader \
    u-boot-script \
"
IMAGE_BOOT_FILES = " \
    rpi-bootfiles/* \
    rpi-config/*\
    ${UBOOT_BINARY} \
    boot.scr \
"
```

## meta-gnx/wic/rpi3.wks
```
bootloader
part /rpi --source bootimg-partition --ondisk mmcblk0 --fstype vfat --active --fixed-size 128M
part / --source rootfs --rootfs-dir ${IMAGE_ROOTFS} --fstype ext4 --fixed-size 1024M
part / --source rootfs --rootfs-dir ${IMAGE_ROOTFS} --fstype ext4 --fixed-size 1024M
```
